/**
 * \file
 *
 * \brief Empty user application template
 *
 */

/**
 * \mainpage User Application template doxygen documentation
 *
 * \par Empty user application template
 *
 * Bare minimum empty user application template
 *
 * \par Content
 *
 * -# Include the ASF header files (through asf.h)
 * -# "Insert system clock initialization code here" comment
 * -# Minimal main function that starts with a call to board_init()
 * -# "Insert application code here" comment
 *
 */

/*
 * Include header files for all drivers that have been imported from
 * Atmel Software Framework (ASF).
 */
/*
 * Support and FAQ: visit <a href="http://www.atmel.com/design-support/">Atmel Support</a>
 */
#include "asf.h"
#define F_CPU 16000000UL
#include <avr/io.h>
#include "uart.h"
#include <util/delay.h>
#include <avr/interrupt.h>
#include <avr/pgmspace.h>
#include <string.h>
#define OLED_CONTROL_PORT_DDR DDRB
#define OLED_CONTROL_PORT PORTB
#define OLED_DC PORTB0
#define OLED_CS PORTB1
#define OLED_WR PORTD7
#define OLED_COL_START 0x1C
#define OLED_COL_END 0x5B
#define OLED_ROW_START 0x00
#define OLED_ROW_END 0x3f
#define BUFF_LENGTH 10 //length of buffers in respect to bytes
FILE uart_str = FDEV_SETUP_STREAM(uart_putchar, uart_getchar, _FDEV_SETUP_RW);
char rec[256]; // Declare a character buffer

const unsigned char font8x8_basic[128][8] = {
	{ 0x00, 0x00, 0x00, 0x00, 0x00, 0x00, 0x00, 0x00},   // U+0000 (nul)
	{ 0x00, 0x00, 0x00, 0x00, 0x00, 0x00, 0x00, 0x00},   // U+0001
	{ 0x00, 0x00, 0x00, 0x00, 0x00, 0x00, 0x00, 0x00},   // U+0002
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	{ 0x00, 0x00, 0x00, 0x00, 0x00, 0x00, 0x00, 0x00}    // U+007F
};
//#include "SRAM.h" //custom SRAM library
/* * Port/Signals Definitions for SRAM */
volatile uint8_t test;
uint16_t row = 0x00; //start at row 0
uint16_t col = 0x1c; //start at col 0
uint8_t write_buffer[BUFF_LENGTH] = {0xa0,0,0,0,0,0,0,0,0,0};
uint8_t read_buffer[BUFF_LENGTH];
void OLED_Config_Data_Port_Output(){
	DDRC |= 0x3f; //data port config 
	DDRD |= 0x0c;
	PORTC &= ~(0x3f);
	PORTD &= ~(0x0c);
}
void OLED_Config_Control_Port(){
	DDRD |= (1<<OLED_WR) | (1<<PORTD6);
	PORTD |= (1<<OLED_WR) | (1<<PORTD6);
	OLED_CONTROL_PORT_DDR |= (0x07);
	OLED_CONTROL_PORT |= ( (1<<OLED_DC) | (1<<OLED_CS));
}
void OLED_Write_Command(uint8_t cmd, uint8_t data, uint8_t data1, uint8_t select){
	PORTC &= ~(0x3f);
	PORTD &= ~(0x0c);//clear ports
	PORTC |= (0x3f & cmd);
	PORTD |= (0x0c &(cmd >> 4)); //align data
	OLED_CONTROL_PORT &= ~(1<<OLED_DC);
	OLED_CONTROL_PORT &= ~(1<<OLED_CS); //pull cs low for command option and enable chip
	PORTD &= ~(1<<OLED_WR);
	PORTD |= (1<<OLED_WR); //latch command
	if (select>0){ //latch data if select isnt 0 
		PORTC &= ~(0x3f); //clear port
		PORTD &= ~(0x0c);
		PORTC |= (0x3f & data);
		PORTD |= (0x0c &(data >> 4)); //align new data
		OLED_CONTROL_PORT |= (1<<OLED_DC); //set to data mode
		PORTD &= ~(1<<OLED_WR);
		PORTD |= (1<<OLED_WR); //latch command
		if(select > 1){ //latch data 1 if select is greater than 1
			PORTC &= ~(0x3f); //clear port
			PORTD &= ~(0x0c);
			PORTC |= (0x3f & data1);
			PORTD |= (0x0c &(data1 >> 4)); //align new data
			PORTD &= ~(1<<OLED_WR);
			PORTD |= (1<<OLED_WR); //latch command
		}
	}
	OLED_CONTROL_PORT |= (1<<OLED_CS); //end command
}
void OLED_Write_Command_only(uint8_t cmd){
	PORTC &= ~(0x3f);
	PORTD &= ~(0x0c);//clear ports
	PORTC |= (0x3f & cmd);
	PORTD |= (0x0c &(cmd >> 4)); //align data
	OLED_CONTROL_PORT &= ~(1<<OLED_DC);
	OLED_CONTROL_PORT &= ~(1<<OLED_CS); //pull cs low for command option and enable chip
	PORTD &= ~(1<<OLED_WR);
	PORTD |= (1<<OLED_WR); //latch command
}
void OLED_Write_Data(uint8_t data){
	PORTC &= ~(0x3f); //clear port
	PORTD &= ~(0x0c);
	PORTC |= (0x3f & data);
	PORTD |= (0x0c &(data >> 4)); //align new data
	OLED_CONTROL_PORT |= (1<<OLED_DC); //set to data mode
	PORTD &= ~(1<<OLED_WR);
	PORTD |= (1<<OLED_WR); //latch command
}
void OLED_Print_Character8x8(uint8_t data, uint16_t x, uint16_t y){ //INDEXING STARTS AT 0,0
	uint8_t control_mask = 0b10000000;
	int inc = row;
	uint8_t packet = 0x00;
	OLED_Write_Command(0x15,0x1c+x,0x5b,1); // set column adress
	OLED_Write_Command(0x75,inc+y,0x3f,1); // set row adress
	for(int i = 0; i <= 7; i++){
		OLED_Write_Command_only(0x5c);
		if(control_mask & font8x8_basic[data][i]){
			packet |= 0xf0;
		}
		control_mask = 0b00000001;
		if(control_mask & font8x8_basic[data][i]){
			packet |= 0x0f;
		}
		control_mask = control_mask * 2;
		OLED_Write_Data(packet);
		packet = 0x00;
		if(control_mask & font8x8_basic[data][i]){
			packet |= 0xf0;
		}
		control_mask = control_mask * 2;
		if(control_mask & font8x8_basic[data][i]){
			packet |= 0x0f;
		}
		control_mask = control_mask * 2;
		OLED_Write_Data(packet);
		packet = 0x00;
		if(control_mask & font8x8_basic[data][i]){
			packet |= 0xf0;
		}
		control_mask = control_mask * 2;
		if(control_mask & font8x8_basic[data][i]){
			packet |= 0x0f;
		}
		control_mask = control_mask * 2;
		OLED_Write_Data(packet);
		packet = 0x00;
		if(control_mask & font8x8_basic[data][i]){
			packet |= 0xf0;
		}
		control_mask = control_mask * 2;
		if(control_mask & font8x8_basic[data][i]){
			packet |= 0x0f;
		}
		control_mask = control_mask * 2;
		OLED_Write_Data(packet);
		packet = 0x00;
	   OLED_CONTROL_PORT |= (1<<OLED_CS);
	   inc++;
	   OLED_Write_Command(0x15,0x1c+x,0x5b,2); // set column adress
	   OLED_Write_Command(0x75,inc+y,0x3f,1); // set row adress
	}
}
void OLED_Print_String(char* _string, uint16_t x, uint16_t y ){
	for(int i = 0; i <= strlen(_string); i++){
		OLED_Print_Character8x8(_string[i], i*2 + x, y);
	}
}
void SPI_MasterInit(void)
{
	/* Set SS, MOSI and SCK output, all others input */
	DDRB = (1<<PORTB2) | (1<<PORTB3) | (1<<PORTB5);
	/* Enable SPI, Master, set clock rate fck/128 */
	SPCR = (1<<SPE) | (1<<MSTR) | (1<<SPR1) | (1<<SPR0);
	PORTB |= (1<<PORTB2);
}
uint8_t SPI_Master_Transceive(uint8_t cData)
{
	PORTB &= ~(1<<PORTB2); // Pull Slave_Select low
	SPDR = cData; // Start transmission
	while( !(SPSR & (1<<SPIF)) ); // Wait for transmission complete
	PORTB |= (1<<PORTB2); // Pull Slave Select High
	return SPDR; // Return received data
}
void SPI_Master_Traceive_Buffer(uint8_t *wd_buffer, uint8_t *rd_buffer, uint8_t size){
	PORTB &= ~(1<<PORTB2); // Pull Slave_Select low
	for(int i = 0; i < size; i++){
		SPDR = wd_buffer[i];
		while( !(SPSR & (1<<SPIF)) ); // Wait for transmission complete
		rd_buffer[i] = SPDR;
	}
	PORTB |= (1<<PORTB2); // Pull Slave Select High
}
int main (void)
{
	board_init();
	SPI_MasterInit();
	OLED_Config_Data_Port_Output();
	OLED_Config_Control_Port();
	OLED_Write_Command(0xFD,0x12,0x00,1); // unlock oled
	OLED_Write_Command(0xa4,0x00,0x00,0); // turn off display
	OLED_Write_Command(0x15,0x1c,0x5b,2); // set column adress
	OLED_Write_Command(0x75,0x00,0x3f,2); // set row adress
	OLED_Write_Command(0xb3,0x91,0x00,1); // set clock
	OLED_Write_Command(0xCA,0x3f,0x00,1); // set multiplex
	OLED_Write_Command(0xa2,0x00,0x00,1); // display offset
	OLED_Write_Command(0xa1,0x00,0x00,1); // display start line
	OLED_Write_Command(0xa0,0x00,0x00,0); // remap
	OLED_Write_Command(0xb5,0x00,0x00,1); // disable gpio
	OLED_Write_Command(0xAB,0x01,0x00,0); // function selection
	OLED_Write_Command(0xb4,0xa0,0xfd,2); // ehancement a
	OLED_Write_Command(0xc1,0x9f,0x00,1); // contrast current 
	OLED_Write_Command(0xc7,0x0f,0x00,1); // master current
	OLED_Write_Command(0xb9,0x00,0x00,0); // select default linear grey scale table
	OLED_Write_Command(0xb1,0xe2,0x00,1); // phase length
	OLED_Write_Command(0xd1,0x20,0x00,1); // display enhancement b
	OLED_Write_Command(0xbb,0x1f,0x00,1); // pre charge voltage
	OLED_Write_Command(0xb6,0x08,0x00,1); // pre charge period
	OLED_Write_Command(0xbe,0x07,0x00,1); // set VCOMH
	OLED_Write_Command(0xa6,0x00,0x00,0); // display in normal mode
	char* teststring= "this is a test";
	uart_init();
	stdout = stdin = stderr = &uart_str; // Set File outputs to point to UART stream
	fprintf(stdout, "Hello! \n");
	int x = 0;
	int y = 0;
	while(1)
	{
		fscanf(stdin,"%s",rec);
		if(rec[0] == 0x44 && rec[1] == 0x53 && rec[2] == 0x52){
			
		}
		if(rec[0] != 0){
			for(int i = 0; rec[i] != 0; i++){
				OLED_Print_Character8x8(rec[i],x,y);
				x = x + 2;
				if(x >= 64){
					x = 0;
					y = y + 8;
				}
			}
			OLED_Print_Character8x8(0x20,x,y);
			x = x + 1;
		}
		
	}
}
